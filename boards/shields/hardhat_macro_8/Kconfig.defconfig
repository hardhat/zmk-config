## boards/shields/hardhat_macro_8/Kconfig.defconfig
```kconfig
if SHIELD_HARDHAT_MACRO_8

config ZMK_KEYBOARD_NAME
    default "hardhat_macro_8"

endif # SHIELD_HARDHAT_MACRO_8
```

## boards/shields/hardhat_macro_8/Kconfig.shield
```kconfig
config SHIELD_HARDHAT_MACRO_8
    def_bool $(shields_list_contains,hardhat_macro_8)
```
